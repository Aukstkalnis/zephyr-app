## boards/arm/bluenrg_232/Kconfig.board
```kconfig
# BLUENRG-232 board configuration

# SPDX-License-Identifier: Apache-2.0

config BOARD_BLUENRG_232
	bool "BLUENRG-232 Development Board"
	depends on SOC_BLUENRG
```

## boards/arm/bluenrg_232/Kconfig.defconfig
```kconfig
# STM32F412G-DISCO board configuration

# SPDX-License-Identifier: Apache-2.0

if BOARD_BLUENRG_232

config BOARD
	default "bluenrg_232"

endif # BOARD_BLUENRG_232
```

## boards/arm/bluenrg_232/bluenrg_232_defconfig
```kconfig
# SPDX-License-Identifier: Apache-2.0

CONFIG_SOC_BLUENRG=y

# Enable MPU
CONFIG_ARM_MPU=n

CONFIG_SYS_CLOCK_HW_CYCLES_PER_SEC=32000000

# enable pinmux
CONFIG_PINMUX=y

# enable GPIO port
CONFIG_GPIO=y

CONFIG_PINMUX=y

CONFIG_GEN_ISR_TABLES=y

CONFIG_CONSOLE=y
CONFIG_SHELL=y
CONFIG_SERIAL=y
CONFIG_UART_CONSOLE=n
CONFIG_UART_INTERRUPT_DRIVEN=n

CONFIG_SHELL=y
CONFIG_SHELL_LOG_LEVEL_INF=n
CONFIG_GPIO_SHELL=y
```

## drivers/Kconfig
```kconfig
# drivers configuration options

# Copyright (c) 2015 Intel Corporation
# SPDX-License-Identifier: Apache-2.0

menu "Device Drivers"

source "drivers/interrupt_controller/Kconfig"

source "drivers/gpio/Kconfig"

source "drivers/interrupt_controller/Kconfig.shared_irq"

source "drivers/pinmux/Kconfig"

source "drivers/clock_control/Kconfig"

endmenu
```

## drivers/gpio/Kconfig
```kconfig
# GPIO configuration options

# Copyright (c) 2015 Intel Corporation
# SPDX-License-Identifier: Apache-2.0

menuconfig GPIO
	bool "GPIO Drivers"
	help
	  Include GPIO drivers in system config

if GPIO

module = GPIO
module-str = gpio
source "subsys/logging/Kconfig.template.log_config"

config GPIO_SHELL
	bool "Enable GPIO Shell"
	help
	  Enable GPIO Shell for testing.

source "drivers/gpio/Kconfig.bluenrg"

endif # GPIO
```

## drivers/pinmux/Kconfig.bluenrg
```kconfig
# Configuration for STM32 pinmux

# Copyright (c) 2016 Open-RnD Sp. z o.o.
# SPDX-License-Identifier: Apache-2.0

config PINMUX_BLUENRG
	bool "Pinmux driver for BLUENRG MCUs"
	depends on SOC_BLUENRG
	help
	  Enable pin multiplexer for BLUENRG MCUs

config PINMUX_BLUENRG_DEVICE_INITIALIZATION_PRIORITY
	int "Device initialization priority BLUENRG pinmux"
	depends on PINMUX_STM32
	default 2
	help
	  This option controls the priority of pinmux device initialization.
	  Higher priority ensures that the device is initialized earlier in
	  the startup cycle. Note that the pinmux device needs to be initialized
	  after clock control device, but possibly before all other devices.
	  If unsure, leave at default value 2
```

## drivers/zephyr/Kconfig
```kconfig
# comment "Serial Drivers"

config HAS_BLUENRG_HAL
	bool
	depends on HAS_DTS
	help
	  This option specifies that the target platform supports device tree
	  configuration for WDT.

rsource "serial/Kconfig.bluenrg"
rsource "clock_control/Kconfig.bluenrg"
rsource "spi/Kconfig.bluenrg"
rsource "gpio/Kconfig.bluenrg"
```

## drivers/zephyr/clock_control/Kconfig.bluenrg
```kconfig
# BLUENRG MCU clock control driver config

# Copyright (c) 2020 Linaro
# Copyright (c) 2020 RnDity Sp. z o.o.
# SPDX-License-Identifier: Apache-2.0

config CLOCK_CONTROL_BLUENRG
	bool "BLUENRG GPIO (PORT) driver"
	default y
	depends on SOC_BLUENRG
	select HAS_DTS_GPIO
	help
	  Enable support for the BLUENRG GPIO controllers.

config CLOCK_CONTROL_BLUENRG_DEVICE_INIT_PRIORITY
	int "Clock Control Device Priority"
	default 1
	help
	  This option controls the priority of clock control
	  device initialization. Higher priority ensures that the device
	  is initialized earlier in the startup cycle. If unsure, leave
	  at default value 1
```

## drivers/zephyr/gpio/Kconfig.bluenrg
```kconfig
# BLUENGR GPIO configuration

# Copyright (c) 2016 Open-RnD Sp. z o.o.
# SPDX-License-Identifier: Apache-2.0

config GPIO_BLUENRG
	bool "BLUENRG GPIO (PORT) driver"
	default y
	depends on SOC_BLUENRG
	select HAS_DTS_GPIO
	help
	  Enable support for the BLUENRG GPIO controllers.
```

## drivers/zephyr/pinmux/Kconfig.bluenrg
```kconfig
# Configuration for STM32 pinmux

# Copyright (c) 2016 Open-RnD Sp. z o.o.
# SPDX-License-Identifier: Apache-2.0

config PINMUX_BLUENRG
	bool "Pinmux driver for BLUENRG MCUs"
	depends on SOC_BLUENRG
	help
	  Enable pin multiplexer for BLUENRG MCUs
```

## drivers/zephyr/serial/Kconfig.bluenrg
```kconfig
# BLUENRG UART configuration

# Copyright (c) 2016 Open-RnD Sp. z o.o.
# SPDX-License-Identifier: Apache-2.0

# --- port 1 ---

config UART_1
	bool "Enable BLUENRG USART1 Port"
	help
	  Enable support for USART1 port in the driver.
	  Say y here if you want to use USART1 device.
```

## drivers/zephyr/spi/Kconfig.bluenrg
```kconfig
# BLUENRG UART configuration

# Copyright (c) 2016 Open-RnD Sp. z o.o.
# SPDX-License-Identifier: Apache-2.0

menuconfig SPI_BLUENRG
	bool "BLUENRG MCU SPI controller driver"
	depends on SOC_BLUENRG
	help
	  Enable SPI support on the BLUENRG family of processors.

config SPI_INIT_PRIORITY
	int "Init priority"
	default 70
	help
	  Device driver initialization priority.
```

## dts_root/dts/bindings/spi/st,bluenrg-spi.yaml
```yaml
# Copyright (c) 2018, I-SENSE group of ICCS
# SPDX-License-Identifier: Apache-2.0

description: BlueNRG SPI controller

compatible: "st,bluenrg-spi"

include: spi-controller.yaml

properties:
    reg:
      required: true

    interrupts:
      required: true
```

## external_bluenrg_soc_drivers/zephyr/Kconfig
```kconfig
# comment "Serial Drivers"

config HAS_BLUENRG_HAL
	bool
	depends on HAS_DTS
	help
	  This option specifies that the target platform supports device tree
	  configuration for WDT.

config SPI_BLUENRG
	bool "STM32 MCU SPI controller driver"
	help
	  Enable SPI support on the STM32 family of processors.

# menuconfig SPI_BLUENRG
# 	bool "STM32 MCU SPI controller driver"
# 	depends on SOC_BLUENRG
# 	help
# 	  Enable SPI support on the STM32 family of processors.

if SPI_BLUENRG

config SPI_BLUENRG_INTERRUPT
	bool "BLueNRG MCU SPI Interrupt Support"
	help
	  Enable Interrupt support for the SPI Driver.

endif # SPI_BLUENRG


rsource "clock_control/Kconfig.bluenrg"

rsource "gpio/Kconfig.bluenrg"

rsource "pinmux/Kconfig.bluenrg"

if SERIAL
	rsource "serial/Kconfig.bluenrg"
endif # SERIAL
```

## external_bluenrg_soc_drivers/zephyr/interrupt_controller/Kconfig
```kconfig
# interrupt controller configuration options

# Copyright (c) 2015 Intel Corporation
# SPDX-License-Identifier: Apache-2.0

menu "Interrupt Controllers"

source "Kconfig.stm32"

endmenu
```

## external_bluenrg_soc_drivers/zephyr/serial/Kconfig
```kconfig
# Serial driver configuration options

# Copyright (c) 2014-2015 Wind River Systems, Inc.
# SPDX-License-Identifier: Apache-2.0


if SERIAL

source "drivers/serial/Kconfig.bluenrg"

endif # SERIAL
```

## soc/Kconfig
```kconfig
# SPDX-License-Identifier: Apache-2.0

choice
    prompt "SoC/CPU/Configuration selection"

source "$(SOC_DIR)/$(ARCH)/*/Kconfig.soc"

endchoice

menu "Hardware Configuration"
osource "$(SOC_DIR)/$(ARCH)/*/Kconfig"

endmenu
```

## soc/arm/bluenrg/Kconfig.soc
```kconfig
# Copyright (c) 2019 Lexmark International, Inc.
# Copyright (c) 2019 Stephanos Ioannidis <root@stephanos.io>
# SPDX-License-Identifier: Apache-2.0

config SOC_BLUENRG
	bool "BlueNRG"
	select ARM
	select CPU_CORTEX_M0
	select SOC_FAMILY_BLUENRG
	select BLUENRG
	select HAS_BLUENRG_HAL
	select CPU_CORTEX_M_HAS_SYSTICK
	select CORTEX_M_SYSTICK
	select SERIAL
	select CLOCK_CONTROL
```

## soc/arm/st_bluenrg/Kconfig
```kconfig
# Copyright (c) 2019 Stephanos Ioannidis <root@stephanos.io>
# SPDX-License-Identifier: Apache-2.0

config SOC_BLUENRG
	bool

config NUM_GPIOS
	int "Upper limit of GPIOS"
```

## soc/arm/st_bluenrg/Kconfig.defconfig
```kconfig
# Copyright (c) 2019 Lexmark International, Inc.
# Copyright (c) 2019 Stephanos Ioannidis <root@stephanos.io>
# SPDX-License-Identifier: Apache-2.0

if SOC_BLUENRG

config SOC
	default "st_bluenrg"

config NUM_IRQS
	default 32

config NUM_GPIOS
	default 25

config PINMUX_BLUENRG
	bool
	default y
	depends on PINMUX

config UART_BLUENRG
	bool
	default y
	depends on SERIAL

config SPI_BLUENRG
	bool
	default y
	
endif # SOC_BLUENRG
```
